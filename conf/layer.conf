## conf/layer.conf
```bitbake
# We have a conf and classes directory, add to BBPATH
BBPATH .= ":${LAYERDIR}"

# We have recipes-* directories, add to BBFILES
BBFILES += "${LAYERDIR}/recipes-*/*/*.bb \
            ${LAYERDIR}/recipes-*/*/*.bbappend"

BBFILE_COLLECTIONS += "meta-beagleboneheartbeat"
BBFILE_PATTERN_meta-beagleboneheartbeat = "^${LAYERDIR}/"
BBFILE_PRIORITY_meta-beagleboneheartbeat = "6"

LAYERDEPENDS_meta-beagleboneheartbeat = "core"
LAYERSERIES_COMPAT_meta-beagleboneheartbeat = "zeus"
```
